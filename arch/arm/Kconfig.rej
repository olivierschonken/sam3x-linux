## arch/arm/Kconfig.rej
```kconfig
diff a/arch/arm/Kconfig b/arch/arm/Kconfig	(rejected hunks)
@@ -2274,7 +2315,7 @@ source "kernel/power/Kconfig"
 config ARCH_SUSPEND_POSSIBLE
 	depends on !ARCH_S5PC100
 	depends on CPU_ARM920T || CPU_ARM926T || CPU_SA1100 || \
-		CPU_V6 || CPU_V6K || CPU_V7 || CPU_XSC3 || CPU_XSCALE
+		CPU_V6 || CPU_V6K || CPU_V7 || CPU_XSC3 || CPU_XSCALE || CPU_V7M
 	def_bool y
 
 config ARM_CPU_SUSPEND
```
